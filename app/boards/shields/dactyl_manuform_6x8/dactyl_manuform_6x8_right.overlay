#include "dactyl_manuform_6x8.dtsi"

&default_transform { // The matrix transform for this board is 8 columns over because the left half is 8 columns wide according to the matrix.
    col-offset = <8>;
};

&kscan0 {
    col-gpios
        = <&gpio1 6 GPIO_ACTIVE_HIGH>
        , <&gpio1 4 GPIO_ACTIVE_HIGH>
        , <&gpio0 11 GPIO_ACTIVE_HIGH>
        , <&gpio1 0 GPIO_ACTIVE_HIGH>
        , <&gpio0 24 GPIO_ACTIVE_HIGH>
		, <&gpio0 22 GPIO_ACTIVE_HIGH>
		, <&gpio1 1 GPIO_ACTIVE_HIGH>
        ;
};
