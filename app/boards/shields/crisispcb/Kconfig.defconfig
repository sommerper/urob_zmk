## app/boards/shields/crisispcb/Kconfig.defconfig
```kconfig
# Copyright (c) 2021 The ZMK Contributors
# SPDX-License-Identifier: MIT

if SHIELD_CRISIS

config ZMK_KEYBOARD_NAME
    default "Crisis Keyboard"

endif
```

## app/boards/shields/dactyl_manuform_6x8/Kconfig.shield
```kconfig
config SHIELD_DACTYL_MANUFORM_6x8_LEFT
    def_bool $(shields_list_contains,dactyl_manuform_6x8_left)

config SHIELD_DACTYL_MANUFORM_6x8_RIGHT
    def_bool $(shields_list_contains,dactyl_manuform_6x8_right)
```

## app/boards/shields/dactyl_manuform_cosmos_5x6/Kconfig.defconfig
```kconfig
if SHIELD_DACTYL_MANUFORM_5x6_COSMOS_LEFT

    config ZMK_KEYBOARD_NAME
        default "DMRCOSMOS"

    config ZMK_SPLIT_BLE_ROLE_CENTRAL
        default y

endif

if SHIELD_DACTYL_MANUFORM_5x6_COSMOS_RIGHT

    config ZMK_KEYBOARD_NAME
        default "DMCOSMOS_R"

endif

if SHIELD_DACTYL_MANUFORM_5x6_COSMOS_LEFT || SHIELD_DACTYL_MANUFORM_5x6_COSMOS_RIGHT

    config ZMK_SPLIT
        default y

endif
```

## app/boards/shields/dactyl_manuform_cosmos_5x6/Kconfig.shield
```kconfig
config SHIELD_DACTYL_MANUFORM_5x6_COSMOS_LEFT
    def_bool $(shields_list_contains,dactyl_manuform_5x6_cosmos_left)

config SHIELD_DACTYL_MANUFORM_5x6_COSMOS_RIGHT
    def_bool $(shields_list_contains,dactyl_manuform_5x6_cosmos_right)
```

## app/boards/shields/dactyl_manuform_cosmos_new_5x6/Kconfig.defconfig
```kconfig
if SHIELD_DACTYL_MANUFORM_5x6_COSMOS_NEW_LEFT

    config ZMK_KEYBOARD_NAME
        default "DMRCOSMOSNEW"

    config ZMK_SPLIT_BLE_ROLE_CENTRAL
        default y

endif

if SHIELD_DACTYL_MANUFORM_5x6_COSMOS_NEW_RIGHT

    config ZMK_KEYBOARD_NAME
        default "DMCOSMOSNEW_R"

endif

if SHIELD_DACTYL_MANUFORM_5x6_COSMOS_NEW_LEFT || SHIELD_DACTYL_MANUFORM_5x6_COSMOS_NEW_RIGHT

    config ZMK_SPLIT
        default y

endif
```

## app/boards/shields/dactyl_manuform_cosmos_new_5x6/Kconfig.shield
```kconfig
config SHIELD_DACTYL_MANUFORM_5x6_COSMOS_NEW_LEFT
    def_bool $(shields_list_contains,dactyl_manuform_5x6_cosmos_new_left)

config SHIELD_DACTYL_MANUFORM_5x6_COSMOS_NEW_RIGHT
    def_bool $(shields_list_contains,dactyl_manuform_5x6_cosmos_new_right)
```

## app/boards/shields/dactyl_manuform_high_4x6/Kconfig.defconfig
```kconfig
if SHIELD_DACTYL_MANUFORM_4x6_HIGH_LEFT

    config ZMK_KEYBOARD_NAME
        default "DMHIGH"

    config ZMK_SPLIT_BLE_ROLE_CENTRAL
        default y

endif

if SHIELD_DACTYL_MANUFORM_4x6_HIGH_RIGHT

    config ZMK_KEYBOARD_NAME
        default "DMHIGH_R"

endif

if SHIELD_DACTYL_MANUFORM_4x6_HIGH_LEFT || SHIELD_DACTYL_MANUFORM_4x6_HIGH_RIGHT

    config ZMK_SPLIT
        default y

endif
```

## app/boards/shields/dactyl_manuform_high_4x6/Kconfig.shield
```kconfig
config SHIELD_DACTYL_MANUFORM_4x6_HIGH_LEFT
    def_bool $(shields_list_contains,dactyl_manuform_4x6_high_left)

config SHIELD_DACTYL_MANUFORM_4x6_HIGH_RIGHT
    def_bool $(shields_list_contains,dactyl_manuform_4x6_high_right)
```

## app/boards/shields/dactyl_manuform_resist_4x6/Kconfig.defconfig
```kconfig
if SHIELD_DACTYL_MANUFORM_4x6_RESIST_LEFT

    config ZMK_KEYBOARD_NAME
        default "DMRESIST"

    config ZMK_SPLIT_BLE_ROLE_CENTRAL
        default y

endif

if SHIELD_DACTYL_MANUFORM_4x6_RESIST_RIGHT

    config ZMK_KEYBOARD_NAME
        default "DMRESIST_R"

endif

if SHIELD_DACTYL_MANUFORM_4x6_RESIST_LEFT || SHIELD_DACTYL_MANUFORM_4x6_RESIST_RIGHT

    config ZMK_SPLIT
        default y

endif
```

## app/boards/shields/dactyl_manuform_resist_4x6/Kconfig.shield
```kconfig
config SHIELD_DACTYL_MANUFORM_4x6_RESIST_LEFT
    def_bool $(shields_list_contains,dactyl_manuform_4x6_resist_left)

config SHIELD_DACTYL_MANUFORM_4x6_RESIST_RIGHT
    def_bool $(shields_list_contains,dactyl_manuform_4x6_resist_right)
```

## app/boards/shields/midge/Kconfig.defconfig
```kconfig
# Copyright (c) 2020 The ZMK Contributors
# SPDX-License-Identifier: MIT

if SHIELD_MIDGE_LEFT

config ZMK_KEYBOARD_NAME
	default "MIDGE"

config ZMK_SPLIT_BLE_ROLE_CENTRAL
	default y

endif

if SHIELD_MIDGE_RIGHT

config ZMK_KEYBOARD_NAME
	default "MIDGE_R"

endif

if SHIELD_MIDGE_RIGHT || SHIELD_MIDGE_LEFT

config ZMK_SPLIT
	default y

endif
```

## app/boards/shields/midge/Kconfig.shield
```kconfig
# Copyright (c) 2020 The ZMK Contributors
# SPDX-License-Identifier: MIT

config SHIELD_MIDGE_LEFT
	def_bool $(shields_list_contains,midge_left)

config SHIELD_MIDGE_RIGHT
	def_bool $(shields_list_contains,midge_right)
```

## app/boards/shields/mosquito/Kconfig.defconfig
```kconfig
# Copyright (c) 2021 The ZMK Contributors
# SPDX-License-Identifier: MIT

if SHIELD_MOSQUITO_LEFT

config ZMK_KEYBOARD_NAME
	default "Mosquito"

config ZMK_SPLIT_ROLE_CENTRAL
	default y

endif

if SHIELD_MOSQUITO_LEFT || SHIELD_MOSQUITO_RIGHT

config ZMK_SPLIT
	default y

endif
```

## app/boards/shields/mosquito/Kconfig.shield
```kconfig
# Copyright (c) 2021 The ZMK Contributors
# SPDX-License-Identifier: MIT

config SHIELD_MOSQUITO_LEFT
	def_bool $(shields_list_contains,mosquito_left)

config SHIELD_MOSQUITO_RIGHT
	def_bool $(shields_list_contains,mosquito_right)
```

## app/boards/shields/resistmono/Kconfig.defconfig
```kconfig
# Copyright (c) 2020 The ZMK Contributors
# SPDX-License-Identifier: MIT

if SHIELD_RESISTMONO

config ZMK_KEYBOARD_NAME
    default "resistmono"

endif
```

## app/boards/shields/resistmono/Kconfig.shield
```kconfig
# Copyright (c) 2020 The ZMK Contributors
# SPDX-License-Identifier: MIT

config SHIELD_RESISTMONO
    def_bool $(shields_list_contains,resistmono)
```

## app/boards/shields/wasp/Kconfig.defconfig
```kconfig
# Copyright (c) 2021 The ZMK Contributors
# SPDX-License-Identifier: MIT

if SHIELD_WASP_LEFT

config ZMK_KEYBOARD_NAME
	default "Wasp"

config ZMK_SPLIT_ROLE_CENTRAL
	default y

endif

if SHIELD_WASP_LEFT || SHIELD_WASP_RIGHT

config ZMK_SPLIT
	default y

endif
```

## app/boards/shields/wasp/Kconfig.shield
```kconfig
# Copyright (c) 2021 The ZMK Contributors
# SPDX-License-Identifier: MIT

config SHIELD_WASP_LEFT
	def_bool $(shields_list_contains,wasp_left)

config SHIELD_WASP_RIGHT
	def_bool $(shields_list_contains,wasp_right)
```
