#include <behaviors.dtsi>
#include <dt-bindings/zmk/keys.h>
#include <dt-bindings/zmk/bt.h>
#include <dt-bindings/zmk/outputs.h>
#include <dt-bindings/zmk/mouse.h>
#include "../zmk-nodefree-config/helper.h"
#include "../zmk-nodefree-config/keypos_def/keypos_30keys.h"

#define BASE      0
#define LOWER     1
#define RAISE     2

#define BASEMAC   3
#define LOWERMAC  4
#define RAISEMAC  5

#define NUMPAD    6
#define EXTRAS    7
#define MOUSE     8
#define FUNC      9
#define BLUETOOTH 10
#define ENTERFIX  11
#define GERMAN    12
#define DANISH    13

#define KEYS_L LT0 LT1 LT2 LT3 LT4 LM0 LM1 LM2 LM3 LM4 LB0 LB1 LB2  // left-hand keys
#define KEYS_R RT0 RT1 RT2 RT3 RT4 RM0 RM1 RM2 RM3 RM4 RB0 RB1 RB2  // right-hand keys
#define THUMBS LH1 LH0 RH0 RH1

#define XXX &none
#define ___ &trans

#undef COMBO_TERM
#define COMBO_TERM 40


/ {
    conditional_layers {
        compatible = "zmk,conditional-layers";
        tri_layer {
            if-layers = <LOWER RAISE>;
            then-layer = <EXTRAS>;
        };
        tri_layer_mac {
            if-layers = <LOWERMAC RAISEMAC>;
            then-layer = <EXTRAS>;
        };
    };
};

#define MAKE_HRM(NAME, HOLD, TAP, TRIGGER_POS) \
    ZMK_BEHAVIOR(NAME, hold_tap, \
        flavor = "balanced"; \
        tapping-term-ms = <280>; \
        quick-tap-ms = <175>; \
        bindings = <HOLD>, <TAP>; \
        hold-trigger-key-positions = <TRIGGER_POS>; \
        hold-trigger-on-release; \
        hold-while-undecided; \
    )




// left-hand HRMs
// MAKE_HRM(hml, &kp, &kp, KEYS_R THUMBS_L THUMBS_R)
MAKE_HRM(hml, &kp, &kp, KEYS_R THUMBS)

// right-hand HRMs
// MAKE_HRM(hmr, &kp, &kp, KEYS_L THUMBS_L THUMBS_R)
MAKE_HRM(hmr, &kp, &kp, KEYS_L THUMBS)

&lt {
  tapping-term-ms = <280>;
  quick-tap-ms = <200>; // repeat on tap-into-hold
  flavor = "balanced";
};

&mt {
  tapping-term-ms = <280>;
  quick-tap-ms = <200>; // repeat on tap-into-hold
  flavor = "balanced";
};

#undef COMBO_TERM
#define COMBO_TERM 40


ZMK_COMBO(enter1, &kp ENTER, RH0 RM4, BASE BASEMAC)
ZMK_COMBO(enter2, &kp ENTER, RH0 RH1, BASE BASEMAC)
ZMK_COMBO(enter3, &kp ENTER, RB2 RM4, BASE BASEMAC)
// ZMK_COMBO(comboZ1,     &kp Z,      LM2 LB2, 0)
// ZMK_COMBO(comboZ2,     &kp Z,      LB1 LB2, 0)

// ZMK_COMBO(comboV1,     &kp V,      LM2 LB0, 0)
// ZMK_COMBO(comboV2,     &kp V,      LB1 LB0, 0)

// ZMK_COMBO(comboK1,     &kp K,      RM2 RB0, 0)
// ZMK_COMBO(comboK2,     &kp K,      RB0 RB1, 0)

// ZMK_COMBO(comboSLASH1, &kp SLASH,  RM2 RB2, 0)
// ZMK_COMBO(comboSLASH2, &kp SLASH,  RB1 RB2, 0)

ZMK_COMBO(comboSingleQuote, &kp SINGLE_QUOTE, RH0 RB0, BASE BASEMAC)
ZMK_COMBO(comboDoubleQuote, &kp DOUBLE_QUOTES, LB1 LB0, BASE BASEMAC)
ZMK_COMBO(comboGrave, &kp GRAVE, LB2 LB1, BASE BASEMAC)

ZMK_COMBO(comboComma, &kp COMMA,  RB0 RB1, BASE BASEMAC)
ZMK_COMBO(comboDot,   &kp DOT,    RB1 RB2, BASE BASEMAC)

ZMK_COMBO(comboColon, &kp COLON,  RT0 RT1, BASE BASEMAC)

ZMK_COMBO(comboResetLeft, &sys_reset,  LT0 LT4, 0)
ZMK_COMBO(comboResetRight, &sys_reset,  RT0 RT4, 0)

ZMK_COMBO(comboBootLeft, &bootloader,  LM0 LM4, 0)
ZMK_COMBO(comboBootRight, &bootloader,  RM0 RM4, 0)

// ZMK_COMBO(resetLeft, &bootloader, LT0 LT4, 0)
// ZMK_COMBO(resetRight, &bootloader, RT0 RT4, 0)
// ZMK_COMBO(resetRight, &bootloader, RT0 RT4, 0)

// ZMK_COMBO(comboSlash1, &kp SLASH,  RB0 RM4, 0)
// ZMK_COMBO(comboSlash2, &kp SLASH, RB2 RM4, 0)
// ZMK_COMBO(comboTilde, &kp TILDE,  RB0 RM4, 0)
// ZMK_COMBO(comboCut,  &kp LC(X),   LM4 LB2, 0)
// ZMK_COMBO(comboCopy,  &kp LC(C),  LB2 LB1, 0)
// ZMK_COMBO(comboPaste, &kp LC(V),  LB1 LB0, 0)
// ZMK_COMBO(comboUndo,  &kp LC(Z),  RT3 RT4, 0)
// ZMK_COMBO(comboSemi,  &kp SEMI,   RT3 RT4, 0)

// original colemak dh
//
// qwfpb jluy;
// arstg mneio
// zxcdv kh,./

// original canary
//
// w l y p b   z f o u '
// c r s t g   m n e i a
// q j v d k   x h / , .

// modified canary
//
// . l y p k   b f o u ;
// c r s t g   m n e i a
// w j v d ,   ' h z q x

// modified canary
//
// w l y p g   m f u o z
// c r s t k   b n e i a
//   j v d       h x q

// ZMK_LAYER(default_layer,
//   &kp Q   &kp L         &kp Y         &kp P           &kp G                                             &kp M           &kp F           &kp O         &kp U         &kp X
//   &kp C   &hml LGUI R   &hml LCTRL S  &hml LSHIFT T   &kp K                                             &kp B           &hmr RSHIFT N   &hmr RCTRL E  &hmr RGUI I   &lt ENTERFIX A
// 		 		  &kp J         &kp V         &lt NUMPAD D                                                                     &kp H           &kp W     &kp Z
//  		                                                  &mt LALT TAB  &lt LOWER BSPC    &lt RAISE SPACE   &mt RALT GRAVE
// )

// Semimak false
// w l y p b   z f o u '
// c r s t g   m n e i a
// q j v d k   x h / , .

// QGMLWB
// q g m l w   b j f u ; '
// a r s t d   h n e i o
// z x c v b   k m , . /

// QGMLWY
// q g m l w   y j f u ; '
// a r s t d   h n e i o
// z x c v b   k m , . /

// Semimak
// f l h v z  ' w u o y
// s r n t k  c d e a i
// x j b m q  p g , . /

// Just Rhea
// j y o u -  v d l c p
// r i e a .  m h t s n
// x / ' , ;  k f g w b

// Qure
// qyou- vdlcp
// riea. mhtsn
// x/',; kfgwb

// Qure 30
// qyoub vdlcp
// rieam khtsn
//  jxz   fgw

// .youbvdlc;
// rieamkhtsn
// qjxz,'fgwp

// Qure reversed
// pcldv buoyq
// nsthk maeir
//  wgf   zxj

// ' c l d v j u o y ;
// n s t h k m a e i r
// z w g f , . p x b q

// . c l d b j u o y ;
// n s t h g m a e i r
// z p w f , / k x v q

// Qure reversed
//  cldv buoy
// nsthk maeir
// pwgf   zxjq

// new colemak dh
//
// .wfpb jluoy
// krstg mneia
// qxcd, 'hvz;

// new colemak dh 30
//
// .wfpb jluyz
// arstg mneio
// qkcd, 'hxv;

// Qure reversed
// ZMK_LAYER(default_layer,
//   &kp Q   &kp W         &kp F         &kp P           &kp B                                             &kp J           &kp L           &kp U         &kp Y         &kp Z
//   &kp A   &hml LGUI R   &hml LCTRL S  &hml LSHIFT T   &kp G                                             &kp M           &hmr RSHIFT N   &hmr RCTRL E  &hmr RGUI I   &lt ENTERFIX O
// 		 		  &kp K         &kp C         &lt NUMPAD D                                                                     &kp H           &kp X     &kp V
//  		                                                  &mt LALT TAB  &lt LOWER BSPC    &lt RAISE SPACE   &mt RALT GRAVE
// )


// Qure reversed
// ZMK_LAYER(default_layer,
//   &kp P   &kp C         &kp L         &kp D           &kp B                                             &kp V           &kp U           &kp O         &kp Y         &kp Q
//   &kp N   &hml LGUI S   &hml LCTRL T  &hml LSHIFT H   &kp K                                             &kp M           &hmr RSHIFT A   &hmr RCTRL E  &hmr RGUI I   &lt ENTERFIX R
// 		 		  &kp W         &kp G         &lt NUMPAD F                                                                     &kp Z           &kp X     &kp J
//  		                                                  &mt LALT TAB  &lt LOWER BSPC    &lt RAISE SPACE   &mt RALT GRAVE
// )

// // Canary
// ZMK_LAYER(default_layer,
//   &kp W   &kp L         &kp Y         &kp P           &kp B                                             &kp K           &kp F           &kp O         &kp U         &kp Z
//   &kp C   &hml LGUI R   &hml LCTRL S  &hml LSHIFT T   &kp G                                             &kp M           &hmr RSHIFT N   &hmr RCTRL E  &hmr RGUI I   &lt ENTERFIX A
// 		 		  &kp J         &kp V         &lt NUMPAD D                                                                     &kp H           &kp X     &kp Q
//  		                                                  &mt LALT TAB  &lt LOWER BSPC    &lt RAISE SPACE   &mt RALT GRAVE
// )

// tap: space | shift + tap: dot -> space -> sticky shift | hold: activate layer
ZMK_BEHAVIOR(lt_spc, hold_tap,
    flavor = "balanced";
    tapping-term-ms = <200>;
    // quick-tap-ms = <175>;
    bindings = <&mo>, <&spc_morph>;
)

ZMK_BEHAVIOR(spc_morph, mod_morph,
    bindings = <&kp SPACE>, <&dot_spc>;
    mods = <(MOD_LSFT|MOD_RSFT)>;
)

ZMK_BEHAVIOR(dot_spc, macro,
    wait-ms = <0>;
    tap-ms = <5>;
    bindings = <&kp DOT &kp SPACE &sk LSHFT>;
)
// ----------------------------
ZMK_BEHAVIOR(alt_spc, hold_tap,
    flavor = "balanced";
    tapping-term-ms = <200>;
    // quick-tap-ms = <175>;
    bindings = <&kp>, <&alt_morph>;
)

ZMK_BEHAVIOR(alt_morph, mod_morph,
    bindings = <&kp DOT>, <&kp COMMA>;
    // bindings = <&kp DOT>, <&dot_alt>;
    mods = <(MOD_LSFT|MOD_RSFT)>;
)
// ----------------------------

// -----------------------------
ZMK_BEHAVIOR(alt_sqt, hold_tap,
    flavor = "balanced";
    tapping-term-ms = <200>;
    // quick-tap-ms = <175>;
    bindings = <&kp>, <&alt_morph_sqt>;
)

ZMK_BEHAVIOR(alt_morph_sqt, mod_morph,
    bindings = <&kp SQT>, <&kp COMMA>;
    // bindings = <&kp DOT>, <&dot_alt>;
    mods = <(MOD_LSFT|MOD_RSFT)>;
)
// ----------------------------

// ZMK_BEHAVIOR(dot_alt, macro,
//     wait-ms = <0>;
//     tap-ms = <5>;
//     bindings = <&kp DOT &kp SPACE &sk LSHFT>;
// )


// tap: copy | double-tap: cut
ZMK_BEHAVIOR(copy_cut, tap_dance,
    tapping-term-ms = <200>;
    bindings = <&kp LC(INS)>, <&kp LC(X)>;
)

ZMK_BEHAVIOR(copy_cut_mac, tap_dance,
    tapping-term-ms = <200>;
    bindings = <&kp LG(C)>, <&kp LG(X)>;
)

ZMK_BEHAVIOR(dot_comma, tap_dance,
    tapping-term-ms = <200>;
    bindings = <&kp DOT>, <&kp COMMA>;
)


// -------------------------------------------------------------------
// Linux start
// -------------------------------------------------------------------

ZMK_LAYER(BASE,
  &lt DANISH Q   &kp C         &kp L         &kp D           &kp K                                             &kp J           &kp F           &kp O         &kp U         &kp Z
  &lt GERMAN R   &hml LGUI S   &hml LCTRL T  &hml LSHIFT H   &kp G                                             &kp M           &hmr RSHIFT N   &hmr RCTRL E  &hmr RGUI I   &lt ENTERFIX A
		 		         &kp W         &kp V         &lt NUMPAD B                                                                      &kp P           &kp X         &kp Y
 		                                                  &mt LALT TAB  &lt LOWER BSPC    &lt_spc RAISE 0  &alt_sqt RALT 0
)

// ZMK_LAYER(BASE,
//   &lt DANISH R   &kp C         &kp L         &kp D           &kp K                                             &kp J           &kp F           &kp O         &kp U         &kp A
//   &lt GERMAN Q   &hml LGUI S   &hml LCTRL T  &hml LSHIFT H   &kp G                                             &kp M           &hmr RSHIFT N   &hmr RCTRL E  &hmr RGUI I   &lt ENTERFIX Z
// 		 		         &kp W         &kp V         &lt NUMPAD B                                                                      &kp P           &kp X         &kp Y
//  		                                                  &mt LALT TAB  &lt LOWER BSPC    &lt_spc RAISE 0  &alt_sqt RALT 0
// )

ZMK_LAYER(LOWER,
  &kp ESC     &kp K_VOL_DN  &kp K_MUTE  &kp K_VOL_UP  &mo BLUETOOTH                   &kp DQT   &kp HOME  &kp GRAVE &kp END   &tog BASEMAC
	&caps_word  &kp LGUI      &kp LCTRL   &kp LSHIFT    &kp DEL                         &kp SQT   &kp LEFT  &kp UP    &kp RIGHT &kp LC(SLASH)
	               &kp LC(Z)     &copy_cut   &kp LS(INS)                                             &kp PG_UP &kp DOWN  &kp PG_DN
				                                                &kp DEL   ___          &lt RAISE MINUS    &kp DOT
)

ZMK_LAYER(RAISE,
  &kp BACKSLASH  &kp AT    &kp HASH  &kp DOLLAR  &kp PERCENT                               &kp CARET     &kp AMPS      &kp LPAR      &kp RPAR      &kp SEMI
  &kp EXCL       &kp LT    &kp SLASH &kp GT      &kp QMARK                                 &kp EQUAL     &kp PIPE      &kp LBRC      &kp RBRC      &kp ENTER
                 &kp TILDE &kp MINUS &kp DOT                                                             &kp ASTERISK  &kp LBKT      &kp RBKT
                                        &kp COMMA  &lt LOWER UNDERSCORE        ___      &kp EQUAL
)

// -------------------------------------------------------------------
// Linux end
// -------------------------------------------------------------------


// -------------------------------------------------------------------
// Mac start
// -------------------------------------------------------------------

ZMK_LAYER(BASEMAC,
  &lt DANISH Q   &kp C         &kp L         &kp D           &kp K                                             &kp J           &kp F           &kp O         &kp U         &kp Z
  &lt GERMAN R   &hml LGUI S   &hml LCTRL T  &hml LSHIFT H   &kp G                                             &kp M           &hmr RSHIFT N   &hmr RCTRL E  &hmr RGUI I   &lt ENTERFIX A
		 		         &kp W         &kp V         &lt NUMPAD B                                                                      &kp P           &kp X     &kp Y
 		                                                  &mt LALT TAB  &lt LOWERMAC BSPC    &lt_spc RAISEMAC 0  &alt_spc RALT 0
)

ZMK_LAYER(LOWERMAC,
	&kp ESC       &kp K_VOL_DN  &kp K_MUTE  &kp K_VOL_UP  &mo BLUETOOTH                   &kp SQT   &kp HOME  &kp GRAVE &kp END   XXX
	&kp LG(Z)     &kp LGUI      &kp LCTRL   &kp LSHIFT    &caps_word                      &kp DQT   &kp LEFT  &kp UP    &kp RIGHT &kp LC(SLASH)
	              &kp LG(LS(Z)) &copy_cut_mac   &kp LG(V)                                           &kp PG_UP &kp DOWN  &kp PG_DN
				                                                &kp DEL   ___          &lt RAISEMAC MINUS    ___
)

ZMK_LAYER(RAISEMAC,
  &kp EXCL      &kp AT    &kp HASH  &kp DOLLAR  &kp PERCENT                               &kp CARET     &kp AMPS      &kp LPAR      &kp RPAR      &kp SEMI
  &kp BACKSLASH &kp LT    &kp SLASH &kp GT      &kp QMARK                                 &kp ASTERISK  &kp PIPE      &kp LBRC      &kp RBRC      &kp ENTER
                &kp TILDE &kp MINUS &kp DOT                                                             &kp LBKT      &kp RBKT      &kp EQUAL
                                            &kp BACKSLASH &lt LOWERMAC UNDERSCORE        ___      &kp EQUAL
)


// -------------------------------------------------------------------
// Mac end
// -------------------------------------------------------------------

ZMK_LAYER(NUMPAD,
  &none   &none         &none           &none   &none                         &kp KP_DIVIDE   &kp KP_N7   &kp KP_N8   &kp KP_N9   &kp KP_MINUS
  &none   &kp EXCL      &kp EQL         &none   &none                         &kp KP_MULTIPLY &kp KP_N4   &kp KP_N5   &kp KP_N6   &kp KP_PLUS
          &kp CAPSLOCK  &kp KP_NUMLOCK  &trans                                                &kp KP_N1   &kp KP_N2   &kp KP_N3
                                                &trans  &trans    &kp KP_N0   &dot_comma
)



ZMK_LAYER(EXTRAS,
  &none   &none   &none   &none   &none                     &kp F12  &kp F7  &kp F8  &kp F9  &kp F10
  &none   &none   &none   &none   &none                     &kp F13  &kp F4  &kp F5  &kp F6  &kp F11
                  &none   &none   &none                              &kp F1  &kp F2  &kp F3
                                  &trans  &trans    &trans  &trans
)

ZMK_LAYER(MOUSE,
  &none   &none   &none   &none   &none             &none    &none                &none                   &none                 &none
  &none   &none   &none   &none   &none             &none    &mmv MOVE_HOR(-1500) &mmv MOVE_VERT(-1500)   &mmv MOVE_HOR(1500)   &none
          &none   &none   &none                              &mkp LCLK            &mmv MOVE_VERT(1500)    &mkp RCLK
                                  &trans  &trans    &trans   &trans
)

ZMK_LAYER(FUNC,
  &none   &none   &none   &none   &none                     &kp F12  &kp F7  &kp F8  &kp F9  &kp F10
  &none   &none   &none   &none   &none                     &kp F13  &kp F4  &kp F5  &kp F6  &kp F11
                  &none   &none   &none                              &kp F1  &kp F2  &kp F3
                                  &trans  &trans    &trans  &trans
)

ZMK_LAYER(BLUETOOTH,
  &bootloader   &none   &none   &none   &none              &out OUT_BLE   &out OUT_USB  &none         &none         &none
  &sys_reset    &none   &none   &none   &none              &bt BT_CLR     &bt BT_SEL 4  &bt BT_SEL 5  &none         &none
                &none   &none   &none   &none                             &bt BT_SEL 1  &bt BT_SEL 2  &bt BT_SEL 3
                                        &trans  &trans     &bt BT_SEL 0   &trans
)

ZMK_LAYER(ENTERFIX,
  &trans  &trans  &trans  &trans  &trans                        &trans  &trans  &trans  &trans  &trans
  &trans  &trans  &trans  &trans  &trans                        &trans  &trans  &trans  &trans  &trans
          &trans  &trans  &trans                                        &trans  &trans  &trans
                                  &trans  &trans    &kp ENTER   &trans
)


ZMK_LAYER(GERMAN,
  &trans  &trans     &trans  &trans  &trans                        &trans  &trans  &kp RA(P)  &kp RA(Y)  &trans
  &trans  &kp RA(S)  &trans  &trans  &trans                        &trans  &trans  &trans     &trans     &kp RA(Q)
          &trans     &trans  &trans                                        &trans  &trans     &trans
                                     &trans  &trans      &trans    &trans
)

ZMK_LAYER(DANISH,
  &trans  &trans     &trans  &trans  &trans                        &trans  &trans  &kp RA(L)  &kp RA(W)  &trans
  &trans  &kp RA(S)  &trans  &trans  &trans                        &trans  &trans  &trans     &trans     &kp RA(Z)
          &trans     &trans  &trans                                        &trans  &trans     &trans
                                     &trans  &trans      &trans    &trans
)

